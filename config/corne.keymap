#define CONFIG_WIRELESS

#define ZMK_BASE_LAYER(name, LT, RT, LM, RM, LB, RB, LH, RH)                   \
    ZMK_LAYER(                                                                 \
        name,                                                                  \
        &kp ESC     LT  RT   &kp LBKT                                          \
        &kp TAB     LM  RM   &kp RBKT                                          \
        &kp CAPS    LB  RB   &kp BSLH                                          \
        &kp LALT    LH  RH   &kp DEL                                           \
    )

#include "continuum/matrix/42.h"
#include "continuum/base.keymap"
