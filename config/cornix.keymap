#define CONFIG_WIRELESS

#define ZMK_BASE_LAYER(name, LT, RT, LM, RM, LB, RB, LH, RH)                                                              \
    ZMK_LAYER(                                                                                                            \
        name,                                                                                                             \
        &kp ESC   LT                                                                                   RT       &kp LBKT  \
        &kp TAB   LM                                                                                   RM       &kp RBKT  \
        &kp CAPS  LB                  LEC_BINDING(&kp C_MUTE)  REC_BINDING(&kp PRINTSCREEN)            RB       &kp BSLH  \
        &kp INS   &kp LALT  &kp LGUI  &none  LH                RH  &kp RET                   &kp BSPC  &kp DEL  &none,    \
        SENSOR_VOLUME_BINDING  SENSOR_SCROLL_BINDING                                                                      \
    )

#include "continuum/utils/encoders.h"
#include "continuum/matrix/cornix.h"
#include "continuum/base.keymap"
