## boards/arm/cornix/Kconfig.board
```kconfig
config BOARD_CORNIX_LEFT
    bool "cornix left"
    depends on SOC_NRF52840_QIAA

config BOARD_CORNIX_RIGHT
    bool "cornix right"
    depends on SOC_NRF52840_QIAA
```

## boards/shields/corne/Kconfig.shield
```kconfig
config SHIELD_CORNE_ZDD_DONGLE
    def_bool $(shields_list_contains,corne_zdd_dongle)
```

## boards/shields/cornix/Kconfig.defconfig
```kconfig
if SHIELD_CORNIX_DONGLE

config ZMK_KEYBOARD_NAME
    default "Cornix ZDD"

config ZMK_SPLIT
    default y

config ZMK_SPLIT_ROLE_CENTRAL
    default y


endif # SHIELD_CORNIX_DONGLE
```

## boards/shields/cornix/Kconfig.shield
```kconfig
config SHIELD_CORNIX_ZDD_DONGLE
    def_bool $(shields_list_contains,cornix_zdd_dongle)
```

## boards/shields/delta_omega/Kconfig.defconfig
```kconfig
if SHIELD_DELTA_OMEGA_LEFT

config ZMK_KEYBOARD_NAME
    default "Delta Omega"

config ZMK_SPLIT_ROLE_CENTRAL
    default y

endif

if SHIELD_DELTA_OMEGA_LEFT || SHIELD_DELTA_OMEGA_RIGHT

config ZMK_SPLIT
    default y

endif

if SHIELD_DELTA_OMEGA_DONGLE || SHIELD_DELTA_OMEGA_LEFT_W_DONGLE

config ZMK_SPLIT
    default y

endif # SHIELD_DELTA_OMEGA_DONGLE || SHIELD_DELTA_OMEGA_LEFT_W_DONGLE

if SHIELD_DELTA_OMEGA_DONGLE

config ZMK_SPLIT_ROLE_CENTRAL
    default y

config ZMK_KEYBOARD_NAME
    default "Delta Omega ZDD"


endif # SHIELD_DELTA_OMEGA_DONGLE
```

## boards/shields/delta_omega/Kconfig.shield
```kconfig
config SHIELD_DELTA_OMEGA_LEFT
    def_bool $(shields_list_contains,delta_omega_left)

config SHIELD_DELTA_OMEGA_RIGHT
    def_bool $(shields_list_contains,delta_omega_right)

config SHIELD_DELTA_OMEGA_LEFT_W_DONGLE
    def_bool $(shields_list_contains,delta_omega_left_w_dongle)

config SHIELD_DELTA_OMEGA_ZDD_DONGLE
    def_bool $(shields_list_contains,delta_omega_zdd_dongle)
```

## boards/shields/eyelash_corne/Kconfig.shield
```kconfig
config SHIELD_EYELASH_CORNE_ZDD_DONGLE
    def_bool $(shields_list_contains,eyelash_corne_zdd_dongle)
```

## boards/shields/eyelash_sofle/Kconfig.shield
```kconfig
config SHIELD_EYELASH_SOFLE_ZDD_DONGLE
    def_bool $(shields_list_contains,eyelash_sofle_zdd_dongle)
```

## boards/shields/sofle/Kconfig.defconfig
```kconfig
if SHIELD_SOFLE_DONGLE

config ZMK_KEYBOARD_NAME
    default "Sofle ZDD"

config ZMK_SPLIT
    default y

config ZMK_SPLIT_ROLE_CENTRAL
    default y


endif # SHIELD_SOFLE_DONGLE
```

## boards/shields/sofle/Kconfig.shield
```kconfig
config SHIELD_SOFLE_ZDD_DONGLE
    def_bool $(shields_list_contains,sofle_zdd_dongle)
```

## boards/shields/totem/Kconfig.defconfig
```kconfig
if SHIELD_TOTEM_LEFT

config ZMK_KEYBOARD_NAME
    default "TOTEM"

config ZMK_SPLIT_ROLE_CENTRAL
    default y

config ZMK_USB
    default y

config ZMK_BLE
    default n

endif

if SHIELD_TOTEM_RIGHT

config ZMK_USB
    default n

config ZMK_BLE
    default y

endif

if SHIELD_TOTEM_LEFT || SHIELD_TOTEM_RIGHT

config ZMK_SPLIT
    default y

endif
```

## boards/shields/urchin/Kconfig.defconfig
```kconfig
if SHIELD_URCHIN_LEFT

config ZMK_KEYBOARD_NAME
    default "Urchin"

config ZMK_SPLIT_ROLE_CENTRAL
    default y

endif

if SHIELD_URCHIN_LEFT || SHIELD_URCHIN_RIGHT

config ZMK_SPLIT
    default y

endif

if SHIELD_URCHIN_DONGLE || SHIELD_URCHIN_LEFT_W_DONGLE

config ZMK_SPLIT
    default y

endif # SHIELD_URCHIN_DONGLE || SHIELD_URCHIN_LEFT_W_DONGLE

if SHIELD_URCHIN_DONGLE

config ZMK_SPLIT_ROLE_CENTRAL
    default y

config ZMK_KEYBOARD_NAME
    default "Urchin ZDD"


endif # SHIELD_URCHIN_DONGLE
```

## config/west.yml
```yaml
manifest:
  defaults:
    revision: v0.3
  remotes:
    - name: zmkfirmware
      url-base: https://github.com/zmkfirmware
    # Additional modules containing boards/shields/custom code can be listed here as well
    # See https://docs.zephyrproject.org/3.2.0/develop/west/manifest.html#projects
    - name: urob
      url-base: https://github.com/urob
  projects:
    - name: zmk
      remote: zmkfirmware
      import: app/west.yml

    # Urob's ZMK modules
    - name: zmk-adaptive-key
      path: modules/zmk/adaptive-key
      remote: urob
    - name: zmk-auto-layer
      path: modules/zmk/auto-layer
      remote: urob
    - name: zmk-helpers
      path: modules/zmk/helpers
      remote: urob
    - name: zmk-leader-key
      path: modules/zmk/leader-key
      remote: urob
    - name: zmk-tri-state
      path: modules/zmk/tri-state
      remote: urob
    - name: zmk-unicode
      path: modules/zmk/unicode
      remote: urob
  self:
    path: config
```
